#include <iarduino_DS18XXX.h>                    // Подключаем библиотеку для работы с датчиками температуры.
iarduino_DS18XXX ts(2);                          // Создаём объект для работы с датчиком указав вывод Arduino к которому он подключён.
                                                 //
byte    addr[8];                                 // Определяем массив для получения адреса устройства.
byte    data[9];                                 // Определяем массив для получения данных датчика.
uint8_t type;                                    // Определяем переменную для получения модели датчика.
float   temp;                                    // Определяем переменную для получения температуры.
                                                 //
void setup(void){                                //
     Serial.begin(9600);                         // Инициируем передачу данных в монитор последовательного порта на скорости 9600 бит/сек
}                                                //
                                                 //
void loop(void){                                 //
//   Выводим адрес устройства:                   //
     Serial.print("Устройство с адресом");       //
     ts.get_Addr(addr);                          // Получаем адрес.
     for(int i=0; i<8; i++){                     //
         Serial.print(" 0x");                    //
         Serial.print(addr[i],HEX);              //
     }                                           //
//   Выводим модель датчика:                     //
     Serial.print(" является датчиком ");        //
     type=ts.get_Type(addr[0]);                  // Получаем модель датчика по первому байту адреса.
     if(type==DS18S20){Serial.print("DS18S20");} //
     if(type==DS18B20){Serial.print("DS18B20");} //
     if(type==DS1822 ){Serial.print("DS1822" );} //
//   Выводим данные полученные от датчика:       //
     Serial.print(" который отправил данные");   //
     ts.get_Data(data);                          // Получаем данные.
     for(int i=0; i<9; i++){                     //
         Serial.print(" 0x");                    //
         Serial.print(data[i],HEX);              //
     }                                           //
//   Выводим температуру:                        //
     Serial.print(" = ");                        //
     ts.get_Temp(temp);                          // Получаем температуру.
     Serial.print(temp);                         //
     Serial.println("°C");                       //
}                                                //